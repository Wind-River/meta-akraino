## conf/distro/akraino.conf
```bitbake
#
# Copyright (C) 2019 Wind River Systems, Inc.
#
#  Licensed under the Apache License, Version 2.0 (the "License");
#  you may not use this file except in compliance with the License.
#  You may obtain a copy of the License at
#
#      http://www.apache.org/licenses/LICENSE-2.0
#
#  Unless required by applicable law or agreed to in writing, software
#  distributed under the License is distributed on an "AS IS" BASIS,
#  WITHOUT WARRANTIES OR CONDITIONS OF ANY KIND, either express or implied.
#  See the License for the specific language governing permissions and
#  limitations under the License.

#@TYPE: Distro
#@NAME: Akraino
#@DESCRIPTION: Akraino Distribution

PREFERRED_PROVIDER_virtual/kernel = "linux-yocto-rt"
PREFERRED_VERSION_linux-yocto-rt = "4.18%"

# Note that layer.conf will only add items to BBFILES for
# the akraino distro (this one).
#
DISTRO_NAME = "Akraino"

# Set software versions
PREFERRED_VERSION_dpdk ?= "18.11.4%"
PREFERRED_VERSION_kubernetes ?= "1.13.5%"
PREFERRED_VERSION_python-ansible = "2.4.4.0%"
PREFERRED_VERSION_python-m2crypto = "0.30.1%"
GOVERSION ?= "1.11%"

# Set preferred providers
PREFERRED_PROVIDER_virtual/monitoring ?= "${@bb.utils.contains('MONITORING_FEATURES', 'zabbix', 'packagegroup-zabbix-monitoring',\
    bb.utils.contains('MONITORING_FEATURES', 'nagios', 'packagegroup-nagios-monitoring', 'packagegroup-empty-monitoring', d),d)}"

PREFERRED_PROVIDER_virtual/libibverbs ?= "libibverbs"

# By default including akraino layer will build Nagios core
MONITORING_FEATURES ?= "nagios core"

# Have graphics and serial in the boot menu when use grub-efi in iso
GRUB_GFXSERIAL = "1"
GRUB_TIMEOUT = "10"

DISTRO_FEATURES_append = " virtualization kvm"
DISTRO_FEATURES_remove = " efi-secure-boot tpm tpm2 ima"
NON_MULTILIB_RECIPES_append = " ceph"

# For images
IMAGE_OVERHEAD_FACTOR="1.1"
IMAGE_FSTYPES += "tar.bz2 live wic.vmdk wic.vdi wic.qcow2"

# Services don't need to be enabled by default
SYSTEMD_AUTO_ENABLE_kubelet_pn-kubernetes = "disable"
SYSTEMD_AUTO_ENABLE_pn-kubernetes = "disable"

SYSTEMD_AUTO_ENABLE_pn-access-management = "disable"
SYSTEMD_AUTO_ENABLE_pn-gpm = "disable"
SYSTEMD_AUTO_ENABLE_pn-etcd = "disable"
SYSTEMD_AUTO_ENABLE_pn-haproxy = "disable"
SYSTEMD_AUTO_ENABLE_pn-infra-ansible = "disable"

SYSTEMD_AUTO_ENABLE_openvswitch-switch_pn-openvswitch = "disable"
SYSTEMD_AUTO_ENABLE_pn-openvswitch = "disable"

# For syslog
VIRTUAL-RUNTIME_syslog = "rsyslog"
RDEPENDS_cloud-init_remove_pn-cloud-init = "sysklogd"
```

## conf/layer.conf
```bitbake
# We have a conf and classes directory, add to BBPATH
BBPATH =. "${LAYERDIR}:"

# We have a packages directory, add to BBFILES
BBFILES += " \
    ${LAYERDIR}/recipes-*/*/*.bb \
    ${LAYERDIR}/recipes-*/*/*.bbappend \
    "

BBFILE_COLLECTIONS += "meta-akraino"
BBFILE_PATTERN_meta-akraino = "^${LAYERDIR}/"
BBFILE_PRIORITY_meta-akraino = "8"


LAYERVERSION_meta-akraino = "1"

LAYERSERIES_COMPAT_meta-akraino = "thud"

LAYER_PATH_meta-akraino = "${LAYERDIR}"

LAYERDEPENDS_meta-akraino = " \
    cloud-services-layer \
    core \
    dpdk \
    efi-secure-boot \
    filesystems-layer \
    gnome-layer \
    meta-python \
    networking-layer \
    openembedded-layer \
    perl-layer \
    realtime \
    security \
    secure-core \
    signing-key \
    tpm-layer \
    virtualization-layer \
    webserver \
"

LAYERDEPENDS_starlingX-layer_remove = "\
    encrypted-storage \
    integrity \
    openstack-aio-deploy-layer \
    openstack-compute-deploy-layer \
    openstack-controller-deploy-layer \
    openstack-qemu-layer \
    openstack-swift-deploy-layer \
    tpm2 \
"

# Variables for Akraino product specific macros
# which is from build-tools/mock/mock.cfg.template
export playbooks_path = "/opt/openstack-ansible/playbooks"
export inventory_path = "/opt/openstack-ansible/inventory"
export roles_path = "${sysconfdir}/ansible/roles"
export installation_root_path = "/${sysconfdir}/lcm/playbooks/installation"
export bootstrapping_path = "${installation_root_path}/bootstrapping"
export provisioning_path = "${installation_root_path}/provisioning"
export postconfig_path = "${installation_root_path}/postconfig"
export finalize_path = "${installation_root_path}/finalize"
export ansible_filter_plugins_path = "${roles_path}/plugins/filter"
export ansible_modules_path = "${roles_path}/plugins/library"
export caas_path = "${localstatedir}/lib/caas"
export caas_container_tar_path = "${caas_path}/images"
export caas_manifest_path = "${caas_path}/manifests"
export caas_chart_path = "${caas_path}/infra-charts"
export caas_libexec_path = "${libexecdir}/caas"
export caas_rbac_manifests_path = "${caas_path}/rbac_manifests"
export caas_danm_crd_path = "${caas_path}/crds"
export cm_config_dir = "${sysconfdir}/cmframework/config"
export cm_caas_config_file = "${cm_config_dir}/caas.yaml"
export caas_lcm_path = "/opt/caas_lcm/"
export secrets_path = "/etc/required-secrets"
```

## wic/akraino-image-rec.wks
```
# short-description: Create a 'pcbios' direct disk image
# long-description: Creates a partitioned legacy BIOS disk image that the user
# can directly dd to boot media.

part /boot --source bootimg-pcbios --ondisk sda --label boot --active --align 1024
part / --source rootfs --use-uuid --fstype=ext4 --label rootfs --align 1024
bootloader  --timeout=0  --append="vga=0 rw oprofile.timer=1 rootwait rootfstype=ext4 console=tty0 console=ttyS0,115200n8"
```
